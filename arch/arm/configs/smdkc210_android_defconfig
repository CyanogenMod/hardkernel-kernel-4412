## drivers/media/video/exynos/Kconfig
```kconfig
#
# Exynos multimedia device drivers
#
config VIDEO_EXYNOS
	bool "Exynos Multimedia Devices"
	depends on ARCH_EXYNOS4 || ARCH_EXYNOS5
	default n
	select VIDEO_FIXED_MINOR_RANGES
	help
	  This is a representative exynos multimedia device.

config VIDEO_EXYNOS_MEMSIZE_FIMC_IS
	int "Memory size in Mega bytes for FIMC-IS"
	depends on VIDEO_EXYNOS
	default "10"
	help
	  This is to assign memory used in FIMC-IS.

if VIDEO_EXYNOS
	source "drivers/media/video/exynos/fimc-is/Kconfig"
	source "drivers/media/video/exynos/fimc-lite/Kconfig"
	source "drivers/media/video/exynos/mipi-csis/Kconfig"
	source "drivers/media/video/exynos/tv/Kconfig"
if ARCH_EXYNOS5
	source "drivers/media/video/exynos/mdev/Kconfig"
	source "drivers/media/video/exynos/gsc/Kconfig"
endif
endif

config MEDIA_EXYNOS
	bool
	help
	  Compile mdev to use exynos5 media device driver.
```

## drivers/media/video/exynos/fimc-lite/Kconfig
```kconfig
config VIDEO_EXYNOS_FIMC_LITE
	bool "Exynos Camera Interface(FIMC-Lite) driver"
	depends on VIDEO_EXYNOS && ARCH_EXYNOS4
	default n
	help
	  This is a v4l2 driver for exynos camera interface device.
```

## drivers/media/video/samsung/Kconfig
```kconfig
config VIDEO_SAMSUNG
	bool "Samsung Multimedia Devices"
	depends on VIDEO_CAPTURE_DRIVERS && VIDEO_V4L2
	select VIDEO_FIXED_MINOR_RANGES
	default n
	help
	  This is a representative video4linux configuration for Samsung multimedia devices.

config VIDEO_SAMSUNG_V4L2
	bool "V4L2 API for digital camera to be contributed by samsung"
	depends on VIDEO_DEV && VIDEO_SAMSUNG
	default n
	help
	  This feature is for new V4L2 APIs all about digital camera

if CPU_EXYNOS4210
	source "drivers/media/video/samsung/fimc/Kconfig"
	source "drivers/media/video/samsung/jpeg/Kconfig"
	source "drivers/media/video/samsung/tvout/Kconfig"
	source "drivers/media/video/samsung/mfc5x/Kconfig"
	source "drivers/media/video/samsung/fimg2d3x/Kconfig"
	source "drivers/media/video/samsung/ump/Kconfig"
	source "drivers/media/video/samsung/mali/Kconfig"
endif

if VIDEO_SAMSUNG
comment "Reserved memory configurations"
config VIDEO_SAMSUNG_MEMSIZE_FIMC0
	int "Memory size in kbytes for FIMC0"
	depends on VIDEO_FIMC || VIDEO_SAMSUNG_S5P_FIMC
	default "5120"

config VIDEO_SAMSUNG_MEMSIZE_FIMC1
	int "Memory size in kbytes for FIMC1"
	depends on VIDEO_FIMC || VIDEO_SAMSUNG_S5P_FIMC
	default "5120"

config VIDEO_SAMSUNG_MEMSIZE_FIMC2
	int "Memory size in kbytes for FIMC2"
	depends on VIDEO_FIMC || VIDEO_SAMSUNG_S5P_FIMC
	default "5120"

config VIDEO_SAMSUNG_MEMSIZE_FIMC3
	int "Memory size in kbytes for FIMC3"
	depends on VIDEO_FIMC || VIDEO_SAMSUNG_S5P_FIMC
	default "5120"

config VIDEO_SAMSUNG_MEMSIZE_MFC
	int "Memory size in kbytes for MFC"
	depends on ((VIDEO_MFC5X) && (VIDEO_MFC_MEM_PORT_COUNT = 1))
	default "65536"

config VIDEO_SAMSUNG_MEMSIZE_MFC0
	int "Memory size in kbytes for MFC port0"
	depends on ((VIDEO_MFC5X) && (!VIDEO_MFC_MEM_PORT_COUNT = 1))
	default "32768"

config VIDEO_SAMSUNG_MEMSIZE_MFC1
	int "Memory size in kbytes for MFC port1"
	depends on ((VIDEO_MFC5X) && (!VIDEO_MFC_MEM_PORT_COUNT = 1))
	default "32768"

config VIDEO_SAMSUNG_MEMSIZE_JPEG
	int "Memory size in kbytes for JPEG"
	depends on VIDEO_JPEG
	default "8192"
endif
```

## drivers/media/video/samsung/mfc5x/Kconfig
```kconfig
#
# Configuration for Multi Format Codecs (MFC)
#

choice
prompt "Select MFC driver type"
default USE_LEGACY_MFC
config USE_LEGACY_MFC
	bool "Lecacy style MFC"
	depends on VIDEO_SAMSUNG && ARCH_EXYNOS4
	select VIDEO_MFC5X
	help
	  Use MFC legacy style driver.

config USE_V4L2_MFC
	bool "V4L2 style MFC"
	depends on VIDEO_V4L2 && PLAT_S5P
	select VIDEO_SAMSUNG_S5P_MFC
	help
	  Use MFC V4L2 style driver.

endchoice

config VIDEO_MFC5X
	bool "Samsung MFC (Multi Format Codec - FIMV 5.x) Driver"
	depends on USE_LEGACY_MFC
	default n
	---help---
	  This is a Samsung Multi Format Codecs (MFC) FIMV V5.x - driver for Samsung S5PV310

config VIDEO_MFC_MAX_INSTANCE
	int "Maximum size of MFC instance (1-4)"
	range 1 4
	depends on VIDEO_MFC5X
	default 1

config VIDEO_MFC_MEM_PORT_COUNT
	int "Default number of MFC memory ports (1-2)"
	range 1 2
	depends on VIDEO_MFC5X
	default 2

config VIDEO_MFC_VCM_UMP
	bool "Support UMP over VCM for MFC"
	depends on VIDEO_MFC5X && VCM_MMU && VIDEO_UMP
	default y

config VIDEO_MFC5X_DEBUG
	bool "MFC driver debug message"
	depends on VIDEO_MFC5X
	default n

config VIDEO_SAMSUNG_S5P_MFC
	tristate "Samsung S5P MFC 5.1 Video Codec"
	depends on USE_V4L2_MFC
	select VIDEOBUF2_CORE
	default n
	help
	  MFC 5.1 driver for V4L2.

choice
	prompt "VB2 memory allocator for MFC"
	depends on VIDEO_SAMSUNG_S5P_MFC
	default S5P_MFC_VB2_CMA if CMA

config S5P_MFC_VB2_ION
	bool "ION"
	depends on ION
	select VIDEOBUF2_ION
	help
	  Use videobuf2 ION allocator for MFC

config S5P_MFC_VB2_CMA
	bool "CMA"
	depends on CMA
	select VIDEOBUF2_CMA
	help
	  Use videobuf2 CMA allocator for MFC

config S5P_MFC_VB2_DMA_POOL
	bool "DMA Pool"
	select VIDEOBUF2_DMA_POOL
	help
	  use videobuf2 DMA pool allocator for MFC

config S5P_MFC_VB2_SDVMM
	bool "SDVMM"
	depends on VCM && VCM_MMU && VIDEO_UMP && S5P_SYSTEM_MMU
	select VIDEOBUF2_SDVMM
	help
	  use videobuf2 SDVMM allocator for MFC
endchoice
```

## drivers/misc/c2c/Kconfig
```kconfig
#
# C2C XXX
#

menuconfig SAMSUNG_C2C
	tristate "C2C Support"
	depends on CPU_EXYNOS4212
	default n
	help
	  It is for supporting C2C driver.

if SAMSUNG_C2C
config C2C_DEBUG
	bool "C2C Debugging - Print C2C debug messages"
	default y
	help
	  Print C2C debug messages.

endif # SAMSUNG_C2C
```

## sound/soc/samsung/srp_ulp/Kconfig
```kconfig
config SND_SAMSUNG_RP
	bool "ULP Audio support"
	help
	  Say Y if you want to support ULP audio.
```
