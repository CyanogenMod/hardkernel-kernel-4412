## arch/arm/configs/smdkc210_android_defconfig
```kconfig
CONFIG_ARM_PATCH_PHYS_VIRT=y
CONFIG_EXPERIMENTAL=y
# CONFIG_SWAP is not set
CONFIG_SYSVIPC=y
CONFIG_CGROUPS=y
CONFIG_CGROUP_DEBUG=y
CONFIG_CGROUP_FREEZER=y
CONFIG_CGROUP_CPUACCT=y
CONFIG_RESOURCE_COUNTERS=y
CONFIG_CGROUP_SCHED=y
CONFIG_RT_GROUP_SCHED=y
CONFIG_BLK_DEV_INITRD=y
CONFIG_KALLSYMS_ALL=y
CONFIG_ASHMEM=y
# CONFIG_AIO is not set
CONFIG_EMBEDDED=y
# CONFIG_SLUB_DEBUG is not set
CONFIG_MODULES=y
CONFIG_MODULE_FORCE_LOAD=y
CONFIG_MODULE_UNLOAD=y
CONFIG_MODULE_FORCE_UNLOAD=y
# CONFIG_BLK_DEV_BSG is not set
CONFIG_ARCH_EXYNOS4=y
CONFIG_S3C_LOWLEVEL_UART_PORT=1
CONFIG_S3C_ADC=y
CONFIG_S3C_DEV_ADC1=y
CONFIG_SAMSUNG_PD=y
CONFIG_S5P_MEM_CMA=y
CONFIG_EXYNOS4_SETUP_THERMAL=y
CONFIG_EXYNOS4_PM_HOTPLUG=y
CONFIG_MACH_SMDKC210=y
CONFIG_MACH_SMDKV310=y
CONFIG_MACH_UNIVERSAL_C210=y
CONFIG_NO_HZ=y
CONFIG_HIGH_RES_TIMERS=y
CONFIG_SMP=y
CONFIG_NR_CPUS=2
CONFIG_PREEMPT=y
CONFIG_AEABI=y
CONFIG_ARCH_SKIP_SECONDARY_CALIBRATE=y
CONFIG_HIGHMEM=y
CONFIG_CMDLINE="console=ttySAC1,115200"
CONFIG_CPU_FREQ=y
CONFIG_CPU_FREQ_DEFAULT_GOV_ONDEMAND=y
CONFIG_CPU_FREQ_GOV_POWERSAVE=y
CONFIG_CPU_FREQ_GOV_USERSPACE=y
CONFIG_CPU_FREQ_GOV_INTERACTIVE=y
CONFIG_CPU_FREQ_GOV_CONSERVATIVE=y
CONFIG_CPU_IDLE=y
CONFIG_VFP=y
CONFIG_NEON=y
# CONFIG_CORE_DUMP_DEFAULT_ELF_HEADERS is not set
CONFIG_BINFMT_MISC=y
CONFIG_WAKELOCK=y
CONFIG_PM_RUNTIME=y
CONFIG_NET=y
CONFIG_PACKET=y
CONFIG_UNIX=y
CONFIG_NET_KEY=y
CONFIG_INET=y
CONFIG_INET_ESP=y
# CONFIG_INET_XFRM_MODE_TUNNEL is not set
# CONFIG_INET_XFRM_MODE_BEET is not set
# CONFIG_INET_LRO is not set
CONFIG_IPV6=y
CONFIG_IPV6_PRIVACY=y
CONFIG_IPV6_ROUTER_PREF=y
CONFIG_IPV6_OPTIMISTIC_DAD=y
CONFIG_INET6_AH=y
CONFIG_INET6_ESP=y
CONFIG_INET6_IPCOMP=y
CONFIG_IPV6_MIP6=y
CONFIG_IPV6_TUNNEL=y
CONFIG_IPV6_MULTIPLE_TABLES=y
CONFIG_NETFILTER=y
CONFIG_PHONET=y
CONFIG_NET_SCHED=y
CONFIG_UEVENT_HELPER_PATH="/sbin/hotplug"
CONFIG_MTD=y
CONFIG_MTD_CHAR=y
CONFIG_MTD_BLOCK=y
CONFIG_MTD_NAND_IDS=y
CONFIG_MTD_ONENAND=y
CONFIG_MTD_ONENAND_SAMSUNG=y
CONFIG_BLK_DEV_LOOP=y
CONFIG_BLK_DEV_RAM=y
CONFIG_BLK_DEV_RAM_SIZE=8192
CONFIG_MISC_DEVICES=y
CONFIG_KERNEL_DEBUGGER_CORE=y
CONFIG_UID_STAT=y
CONFIG_SCSI=y
CONFIG_BLK_DEV_SD=y
CONFIG_CHR_DEV_SG=y
CONFIG_INPUT_EVDEV=y
CONFIG_INPUT_KEYRESET=y
CONFIG_KEYBOARD_SAMSUNG=y
# CONFIG_INPUT_MOUSE is not set
CONFIG_INPUT_TOUCHSCREEN=y
CONFIG_TOUCHSCREEN_S3C2410=y
CONFIG_INPUT_MISC=y
CONFIG_INPUT_KEYCHORD=y
CONFIG_INPUT_UINPUT=y
CONFIG_INPUT_GPIO=y
# CONFIG_VT is not set
# CONFIG_LEGACY_PTYS is not set
CONFIG_SERIAL_8250=y
CONFIG_SERIAL_SAMSUNG=y
CONFIG_SERIAL_SAMSUNG_CONSOLE=y
CONFIG_HW_RANDOM=y
CONFIG_I2C=y
CONFIG_I2C_S3C2410=y
CONFIG_SPI=y
CONFIG_SPI_S3C64XX=y
CONFIG_POWER_SUPPLY=y
CONFIG_BATTERY_SAMSUNG=y
CONFIG_SENSORS_S3C=y
CONFIG_SENSORS_S3C_RAW=y
CONFIG_WATCHDOG=y
CONFIG_S3C2410_WATCHDOG=y
CONFIG_MFD_WM8994=y
CONFIG_REGULATOR=y
CONFIG_REGULATOR_FIXED_VOLTAGE=y
CONFIG_REGULATOR_MAX8649=y
CONFIG_REGULATOR_WM8994=y
CONFIG_MEDIA_SUPPORT=y
CONFIG_VIDEO_DEV=y
# CONFIG_MEDIA_TUNER_SIMPLE is not set
# CONFIG_MEDIA_TUNER_TDA8290 is not set
# CONFIG_MEDIA_TUNER_TDA827X is not set
# CONFIG_MEDIA_TUNER_TDA18271 is not set
# CONFIG_MEDIA_TUNER_TDA9887 is not set
# CONFIG_MEDIA_TUNER_TEA5761 is not set
# CONFIG_MEDIA_TUNER_TEA5767 is not set
# CONFIG_MEDIA_TUNER_MT20XX is not set
# CONFIG_MEDIA_TUNER_MT2060 is not set
# CONFIG_MEDIA_TUNER_MT2266 is not set
# CONFIG_MEDIA_TUNER_MT2131 is not set
# CONFIG_MEDIA_TUNER_QT1010 is not set
# CONFIG_MEDIA_TUNER_XC2028 is not set
# CONFIG_MEDIA_TUNER_XC5000 is not set
# CONFIG_MEDIA_TUNER_MXL5005S is not set
# CONFIG_MEDIA_TUNER_MXL5007T is not set
# CONFIG_MEDIA_TUNER_MC44S803 is not set
# CONFIG_MEDIA_TUNER_MAX2165 is not set
# CONFIG_MEDIA_TUNER_TDA18218 is not set
# CONFIG_MEDIA_TUNER_TDA18212 is not set
CONFIG_VIDEO_M5MO=y
CONFIG_CSI_C=y
CONFIG_VIDEO_SAMSUNG=y
CONFIG_VIDEO_SAMSUNG_V4L2=y
CONFIG_VIDEO_FIMC=y
CONFIG_VIDEO_JPEG=y
CONFIG_VIDEO_MFC5X=y
CONFIG_VIDEO_SAMSUNG_MEMSIZE_FIMC1=14336
CONFIG_VIDEO_SAMSUNG_MEMSIZE_FIMC2=24576
CONFIG_VIDEO_SAMSUNG_MEMSIZE_FIMC3=7168
CONFIG_VIDEO_SAMSUNG_MEMSIZE_MFC0=36864
CONFIG_VIDEO_SAMSUNG_MEMSIZE_MFC1=36864
CONFIG_VIDEO_SAMSUNG_MEMSIZE_JPEG=20480
# CONFIG_RADIO_ADAPTERS is not set
CONFIG_FB=y
CONFIG_FB_S5P=y
CONFIG_SOUND=y
CONFIG_SND=y
# CONFIG_SND_SUPPORT_OLD_API is not set
# CONFIG_SND_VERBOSE_PROCFS is not set
# CONFIG_SND_DRIVERS is not set
# CONFIG_SND_ARM is not set
# CONFIG_SND_SPI is not set
CONFIG_SND_SOC=y
CONFIG_SND_SOC_SAMSUNG=y
CONFIG_SND_SOC_SAMSUNG_SMDK_WM8994=y
# CONFIG_HID_SUPPORT is not set
CONFIG_USB_GADGET=y
CONFIG_USB_GADGET_S3C_OTGD=y
CONFIG_USB_ANDROID=y
CONFIG_USB_ANDROID_ADB=y
CONFIG_USB_ANDROID_MASS_STORAGE=y
CONFIG_MMC=y
CONFIG_MMC_UNSAFE_RESUME=y
CONFIG_MMC_EMBEDDED_SDIO=y
CONFIG_MMC_PARANOID_SD_INIT=y
CONFIG_MMC_BLOCK_DEFERRED_RESUME=y
CONFIG_MMC_SDHCI=y
CONFIG_MMC_SDHCI_S3C=y
CONFIG_MMC_SDHCI_S3C_DMA=y
CONFIG_SWITCH=y
CONFIG_SWITCH_GPIO=y
CONFIG_RTC_CLASS=y
CONFIG_RTC_DRV_S3C=y
CONFIG_STAGING=y
CONFIG_ANDROID=y
CONFIG_ANDROID_BINDER_IPC=y
CONFIG_ANDROID_LOGGER=y
CONFIG_ANDROID_RAM_CONSOLE=y
CONFIG_ANDROID_RAM_CONSOLE_ERROR_CORRECTION=y
CONFIG_ANDROID_TIMED_GPIO=y
CONFIG_ANDROID_LOW_MEMORY_KILLER=y
CONFIG_EXT2_FS=y
CONFIG_EXT4_FS=y
# CONFIG_EXT4_FS_XATTR is not set
# CONFIG_DNOTIFY is not set
CONFIG_FUSE_FS=y
CONFIG_MSDOS_FS=y
CONFIG_VFAT_FS=y
CONFIG_TMPFS=y
CONFIG_TMPFS_POSIX_ACL=y
# CONFIG_NETWORK_FILESYSTEMS is not set
CONFIG_PARTITION_ADVANCED=y
CONFIG_EFI_PARTITION=y
CONFIG_NLS_CODEPAGE_437=y
CONFIG_NLS_ASCII=y
CONFIG_NLS_ISO8859_1=y
CONFIG_PRINTK_TIME=y
CONFIG_MAGIC_SYSRQ=y
CONFIG_DEBUG_FS=y
CONFIG_DEBUG_KERNEL=y
CONFIG_DETECT_HUNG_TASK=y
# CONFIG_DEBUG_PREEMPT is not set
CONFIG_DEBUG_INFO=y
CONFIG_SYSCTL_SYSCALL_CHECK=y
# CONFIG_ARM_UNWIND is not set
CONFIG_DEBUG_USER=y
CONFIG_DEBUG_S3C_UART=1
CONFIG_CRC_CCITT=y
```

## arch/arm/mach-exynos/Kconfig
```kconfig
# arch/arm/mach-exynos/Kconfig
#
# Copyright (c) 2010-2011 Samsung Electronics Co., Ltd.
#		http://www.samsung.com/
#
# Licensed under GPLv2

# Configuration options for the EXYNOS

if ARCH_EXYNOS

choice
	prompt "EXYNOS system type"
	default ARCH_EXYNOS4

config ARCH_EXYNOS4
	bool "Samsung Exynos4"
	select ARM_ERRATA_743622
	select ARM_ERRATA_751472
	select ARM_ERRATA_754322
	help
	  Samsung EXYNOS4 series based systems

config ARCH_EXYNOS5
	bool "Samsung Exynos5"
	help
	  Samsung EXYNOS5 series based systems

endchoice

config CPU_EXYNOS4210
	bool
	select S3C_PL330_DMA
	select PL310_ERRATA_727915
	select ARM_ERRATA_753970
	help
	  Enable EXYNOS4210 CPU support

config CPU_EXYNOS4212
	bool
	select S3C_PL330_DMA
	help
	  Enable EXYNOS4212 CPU support

config CPU_EXYNOS5210
	bool
	help
	  Enable EXYNOS5210 CPU support

config EXYNOS4_CONTENT_PATH_PROTECTION
	bool "Exynos4 Content Path Protection"
	depends on ARM_TRUSTZONE
	default n
	help
	  Enable content path protection of EXYNOS4.

config EXYNOS_MCT
	bool
	default y
	help
	  Use MCT (Multi Core Timer) as kernel timers

config EXYNOS4_DEV_AHCI
	bool
	help
	  Compile in platform device definitions for AHCI

config EXYNOS4_SETUP_FIMD0
	bool
	help
	  Common setup code for FIMD0.

config EXYNOS4_DEV_PD
	bool
	help
	  Compile in platform device definitions for Power Domain

config EXYNOS4_DEV_SYSMMU
	bool
	help
	  Common setup code for SYSTEM MMU in EXYNOS4

config EXYNOS4_DEV_DWMCI
	bool
	help
	  Compile in platform device definitions for DWMCI

config EXYNOS4_SETUP_I2C1
	bool
	help
	  Common setup code for i2c bus 1.

config EXYNOS4_SETUP_I2C2
	bool
	help
	  Common setup code for i2c bus 2.

config EXYNOS4_SETUP_I2C3
	bool
	help
	  Common setup code for i2c bus 3.

config EXYNOS4_SETUP_I2C4
	bool
	help
	  Common setup code for i2c bus 4.

config EXYNOS4_SETUP_I2C5
	bool
	help
	  Common setup code for i2c bus 5.

config EXYNOS4_SETUP_I2C6
	bool
	help
	  Common setup code for i2c bus 6.

config EXYNOS4_SETUP_I2C7
	bool
	help
	  Common setup code for i2c bus 7.

config EXYNOS4_SETUP_KEYPAD
	bool
	help
	  Common setup code for keypad.

config EXYNOS4_SETUP_SDHCI
	bool
	select EXYNOS4_SETUP_SDHCI_GPIO
	help
	  Internal helper functions for EXYNOS4 based SDHCI systems.

config EXYNOS4_SETUP_SDHCI_GPIO
	bool
	help
	  Common setup code for SDHCI gpio.

config EXYNOS4_SETUP_MSHCI
	bool
	depends on S5P_DEV_MSHC
	default y
	select EXYNOS4_SETUP_MSHCI_GPIO
	help
	  Internal helper functions for EXYNOS4 based MSHCI systems.

config EXYNOS4_SETUP_MSHCI_GPIO
	bool
	help
	  Common setup code for MSHCI gpio.

config EXYNOS4_SETUP_FIMC
	bool
	depends on VIDEO_SAMSUNG_S5P_FIMC
	default y
	help
	  Common setup code for the camera interfaces.

config EXYNOS4_SETUP_FIMC0
	bool
	depends on VIDEO_FIMC
	default y
	help
	  Common setup code for the camera interfaces.

config EXYNOS4_SETUP_FIMC1
	bool
	depends on VIDEO_FIMC
	default y
	help
	  Common setup code for the camera interfaces.

config EXYNOS4_SETUP_FIMC2
	bool
	depends on VIDEO_FIMC
	default y
	help
	  Common setup code for the camera interfaces.

config EXYNOS4_SETUP_FIMC3
	bool
	depends on VIDEO_FIMC
	default y
	help
	  Common setup code for the camera interfaces.

config EXYNOS4_SETUP_USB_PHY
	bool
	help
	  Common setup code for USB PHY controller

config EXYNOS4_SETUP_CSIS
	bool
	depends on VIDEO_FIMC_MIPI
	default y
	help
	  Common setup code for MIPI-CSIS

config EXYNOS4_SETUP_FB_S5P
	bool
	default y
	help
	  Setup code for EXYNOS4 FIMD

config EXYNOS4_SETUP_TVOUT
	bool
	default y
	help
	  Common setup code for TVOUT

config EXYNOS4_SETUP_THERMAL
	bool "Use thermal management"
	depends on CPU_FREQ
	help
	  Common setup code for TMU

config EXYNOS4_SETUP_MIPI_DSI
	bool
	depends on FB_S5P_MIPI_DSIM
	default y
	help
	  Common setup code for MIPI_DSIM.

menu "Support dynamic cpu hotplug (Experimental)"
	depends on CPU_EXYNOS4210 && HOTPLUG_CPU && SMP && CPU_FREQ
	config EXYNOS4_PM_HOTPLUG
	bool "Integrated DVFS CPU hotplug"
	default n
	help
	  Support integrated DVFS CPU hotplug
endmenu

# machine support

menu "EXYNOS4 Machines"
	depends on ARCH_EXYNOS4

config MACH_SMDKC210
	bool "SMDKC210"
	select CPU_EXYNOS4210
	select S5P_GPIO_INT
	select S5P_DEV_FIMD0
	select S5P_DEV_FIMD_S5P
	select S5P_DEV_TVOUT
	select S5P_DEV_MFC
	select S5P_DEV_FIMG2D
	select S5P_DEV_USBGADGET
	select S5P_DEV_JPEG
	select S5P_DEV_THERMAL
	select S3C_DEV_RTC
	select S3C_DEV_WDT
	select S3C_DEV_I2C1
	select S3C_DEV_HSMMC2
	select S3C_DEV_HSMMC3
	select S3C_DEV_HWMON if S3C_ADC
	select S5P_DEV_USB_EHCI
	select SAMSUNG_DEV_KEYPAD
	select SAMSUNG_DEV_ADC
	select SAMSUNG_DEV_TS
	select SAMSUNG_DEV_TS1
	select SAMSUNG_DEV_PWM
	select SAMSUNG_DEV_BACKLIGHT
	select EXYNOS4_DEV_PD
	select EXYNOS4_DEV_SYSMMU
	select EXYNOS4_SETUP_FIMD0
	select EXYNOS4_SETUP_I2C1
	select EXYNOS4_SETUP_KEYPAD
	select EXYNOS4_SETUP_SDHCI
	select EXYNOS4_SETUP_FB_S5P
	select EXYNOS4_SETUP_USB_PHY
	help
	  Machine support for Samsung SMDKC210

config MACH_SMDKV310
	bool "SMDKV310"
	select CPU_EXYNOS4210
	select S5P_GPIO_INT
	select S5P_DEV_FIMD0
	select S5P_DEV_FIMD_S5P
	select S5P_DEV_TVOUT
	select S5P_DEV_MFC
	select S5P_DEV_FIMG2D
	select S5P_DEV_USBGADGET
	select S5P_DEV_JPEG
	select S5P_DEV_THERMAL
	select S3C_DEV_RTC
	select S3C_DEV_WDT
	select S3C_DEV_I2C1
	select S3C_DEV_HSMMC2
	select S3C_DEV_HSMMC3
	select S3C_DEV_HWMON if S3C_ADC
	select S5P_DEV_USB_EHCI
	select SAMSUNG_DEV_PWM
	select SAMSUNG_DEV_BACKLIGHT
	select SAMSUNG_DEV_KEYPAD
	select SAMSUNG_DEV_ADC
	select SAMSUNG_DEV_TS
	select SAMSUNG_DEV_TS1
	select EXYNOS4_DEV_PD
	select EXYNOS4_DEV_SYSMMU
	select EXYNOS4_SETUP_FIMD0
	select EXYNOS4_SETUP_I2C1
	select EXYNOS4_SETUP_KEYPAD
	select EXYNOS4_SETUP_SDHCI
	select EXYNOS4_SETUP_FB_S5P
	select EXYNOS4_SETUP_USB_PHY
	help
	  Machine support for Samsung SMDKV310

config MACH_ARMLEX4210
	bool "ARMLEX4210"
	select CPU_EXYNOS4210
	select S3C_DEV_RTC
	select S3C_DEV_WDT
	select S3C_DEV_HSMMC
	select S3C_DEV_HSMMC2
	select S3C_DEV_HSMMC3
	select EXYNOS4_DEV_AHCI
	select EXYNOS4_DEV_SYSMMU
	select EXYNOS4_SETUP_SDHCI
	help
	  Machine support for Samsung ARMLEX4210 based on EXYNOS4210

config MACH_UNIVERSAL_C210
	bool "Mobile UNIVERSAL_C210 Board"
	select CPU_EXYNOS4210
	select S3C_DEV_HSMMC
	select S3C_DEV_HSMMC2
	select S3C_DEV_HSMMC3
	select S3C_DEV_I2C1
	select S3C_DEV_I2C5
	select S5P_DEV_ONENAND
	select EXYNOS4_SETUP_I2C1
	select EXYNOS4_SETUP_I2C5
	select EXYNOS4_SETUP_SDHCI
	help
	  Machine support for Samsung Mobile Universal S5PC210 Reference
	  Board.

config MACH_NURI
	bool "Mobile NURI Board"
	select CPU_EXYNOS4210
	select S3C_DEV_WDT
	select S3C_DEV_HSMMC
	select S3C_DEV_HSMMC2
	select S3C_DEV_HSMMC3
	select S3C_DEV_I2C1
	select S3C_DEV_I2C3
	select S3C_DEV_I2C5
	select S5P_DEV_USB_EHCI
	select EXYNOS4_SETUP_I2C1
	select EXYNOS4_SETUP_I2C3
	select EXYNOS4_SETUP_I2C5
	select EXYNOS4_SETUP_SDHCI
	select EXYNOS4_SETUP_USB_PHY
	select SAMSUNG_DEV_PWM
	help
	  Machine support for Samsung Mobile NURI Board.

config MACH_FPGA4212
	bool "FPGA4212 board"
	select CPU_EXYNOS4212
	help
	  Machine support for Samsung FPGA4212

config MACH_SMDK4212
	bool "SMDK4212 board"
	select CPU_EXYNOS4212
	select S3C_DEV_HSMMC2
	select S5P_DEV_FIMD_S5P
	select S5P_DEV_USBGADGET
	select EXYNOS4_SETUP_SDHCI
	select EXYNOS4_SETUP_FB_S5P
	select EXYNOS4_SETUP_USB_PHY
	select SAMSUNG_DEV_BACKLIGHT
	select SAMSUNG_DEV_PWM
	select EXYNOS4_DEV_PD
	help
	  Machine support for Samsung SMDK4212
endmenu

menu "EXYNOS5 Machines"
	depends on ARCH_EXYNOS5

config MACH_FPGA5210
	bool "FPGA5210 board"
	select CPU_EXYNOS5210
	help
	  Machine support for Samsung FPGA5210
endmenu

menu "MMC/SD slot setup"
depends on PLAT_S5P

comment "SELECT SYNOPSYS CONTROLLER INTERFACE DRIVER"
config EXYNOS4_DEV_DWMCI
	bool "DWMCI"
	depends on PLAT_S5P
	default n
	help
	IF DWMCI is used, SDHC channel 0 is disabled.

config S5P_DEV_MSHC
	bool "MSHCI"
	depends on PLAT_S5P
	default n
	help
	IF MSHC is used, SDHC channel 0 is disabled.

choice
	prompt "Use Special PLL for MSHC"
	depends on PLAT_S5P && S5P_DEV_MSHC
	help
		This feature change MMC4OUT's clock source between MPLL and EPLL
	default EXYNOS4_MSHC_MPLL_40MHZ

config EXYNOS4_MSHC_MPLL_40MHZ
	bool "MPLL"

config EXYNOS4_MSHC_VPLL_46MHZ
	bool "VPLL"

config EXYNOS4_MSHC_EPLL_45MHZ
	bool "EPLL"
endchoice

comment "Use 8-bit bus width"

config EXYNOS4_MSHC_8BIT
        bool "MSHC with 8-bit bus"
	depends on PLAT_S5P && S5P_DEV_MSHC
	default n
	help
	  IF MSHC uses 8-bit bus, SDHC channel 1 is disabled.

config EXYNOS4_SDHCI_CH0_8BIT
	bool "SDHC Channel 0 with 8-bit bus"
	depends on PLAT_S5P && !EXYNOS4_DEV_DWMCI && !S5P_DEV_MSHC
	default n
	help
	  Support HSMMC Channel 0 8-bit bus.
	  If selected, Channel 1 is disabled.

config EXYNOS4_SDHCI_CH2_8BIT
	bool "SDHC Channel 2 with 8-bit bus"
	help
	  Support HSMMC Channel 2 8-bit bus.
	  If selected, Channel 3 is disabled.

comment "Use DDR"
	depends on PLAT_S5P && S5P_DEV_MSHC
config EXYNOS4_MSHC_DDR
        depends on PLAT_S5P && S5P_DEV_MSHC
	bool "MSHC with DDR mode"
	default n
	help
	  Enabling DDR(Dual Data Rate) mode.

endmenu

endif
```

## drivers/gpu/vithar/Kconfig
```kconfig
config VITHAR
	tristate "Enable Vithar DDK"
	default n
	help
	  Chose this option to enable 3D rendering with vithar DDK.
```
